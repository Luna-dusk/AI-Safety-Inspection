## sdkconfig.defaults
```kconfig
# 目标芯片
CONFIG_IDF_TARGET="esp32s3"

# Flash 16 MiB
CONFIG_ESPTOOLPY_FLASHSIZE_16MB=y
CONFIG_ESPTOOLPY_FLASHSIZE="16MB"

# 自定义分区表
CONFIG_PARTITION_TABLE_CUSTOM=y
CONFIG_PARTITION_TABLE_CUSTOM_FILENAME="partitions-16MiB.csv"
CONFIG_PARTITION_TABLE_FILENAME="partitions-16MiB.csv"

# PSRAM 8 MB Octal（ESP32-S3-WROOM-1-N16R8）
# 注意：Octal PSRAM 要求 flash 工作在 DIO 模式（当前已是 dio @ 80MHz）
CONFIG_SPIRAM=y
CONFIG_SPIRAM_MODE_OCT=y
CONFIG_SPIRAM_TYPE_ESPPSRAM64=y
CONFIG_SPIRAM_SPEED_80M=y
CONFIG_SPIRAM_USE_MALLOC=y
CONFIG_SPIRAM_TRY_ALLOCATE_WIFI_LWIP=y
```
